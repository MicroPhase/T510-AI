## board/t510-fnic/buildroot/defconfig
```kconfig
BR2_aarch64=y
BR2_cortex_a53=y
BR2_TOOLCHAIN_EXTERNAL=y
BR2_TOOLCHAIN_EXTERNAL_CUSTOM=y
BR2_TOOLCHAIN_EXTERNAL_PREINSTALLED=y
BR2_TOOLCHAIN_EXTERNAL_PATH="/opt/Xilinx/Vitis/2022.2/gnu/aarch64/lin/aarch64-linux"
BR2_TOOLCHAIN_EXTERNAL_CUSTOM_PREFIX="aarch64-linux-gnu"
BR2_TOOLCHAIN_EXTERNAL_GCC_11=y
BR2_TOOLCHAIN_EXTERNAL_HEADERS_5_14=y
BR2_TOOLCHAIN_EXTERNAL_CUSTOM_GLIBC=y
BR2_TOOLCHAIN_EXTERNAL_CXX=y
BR2_TOOLCHAIN_EXTERNAL_INET_RPC=n
BR2_ROOTFS_DEVICE_CREATION_DYNAMIC_EUDEV=y
BR2_TARGET_GENERIC_HOSTNAME="t510-fnic"
BR2_TARGET_GENERIC_ISSUE="T510 FNIC firmware builder"
BR2_TARGET_GENERIC_ROOT_PASSWD="root"
BR2_TARGET_GENERIC_GETTY_PORT="ttyPS0"
BR2_SYSTEM_DHCP=""
BR2_ROOTFS_OVERLAY="$(BR2_EXTERNAL_MPSOC_IMAGE_BUILDER_PATH)/../board/t510-fnic/buildroot/rootfs-overlay"
BR2_ROOTFS_POST_BUILD_SCRIPT="$(BR2_EXTERNAL_MPSOC_IMAGE_BUILDER_PATH)/../board/t510-fnic/buildroot/post-build.sh"
BR2_TARGET_ROOTFS_CPIO=y
BR2_TARGET_ROOTFS_CPIO_GZIP=y
BR2_PACKAGE_CA_CERTIFICATES=y
BR2_PACKAGE_DROPBEAR=y
BR2_PACKAGE_EUDEV=y
BR2_PACKAGE_ETHTOOL=y
BR2_PACKAGE_IPROUTE2=y
BR2_PACKAGE_I2C_TOOLS=y
BR2_PACKAGE_KMOD=y
BR2_PACKAGE_LIBXCRYPT=y
BR2_PACKAGE_LIBMETAL=y
BR2_PACKAGE_LIBRFDC=y
BR2_PACKAGE_MTD=y
BR2_PACKAGE_ROOTFS_FIXUPS=y
BR2_PACKAGE_T510_FNIC_RFDC=y
```

## buildroot-external/Config.in
```kconfig
menu "MPSOC Image Builder packages"

source "$BR2_EXTERNAL_MPSOC_IMAGE_BUILDER_PATH/package/libmetal/Config.in"
source "$BR2_EXTERNAL_MPSOC_IMAGE_BUILDER_PATH/package/librfdc/Config.in"
source "$BR2_EXTERNAL_MPSOC_IMAGE_BUILDER_PATH/package/t510-fnic-rfdc/Config.in"
source "$BR2_EXTERNAL_MPSOC_IMAGE_BUILDER_PATH/package/rootfs-fixups/Config.in"

endmenu
```

## buildroot-external/package/libmetal/Config.in
```kconfig
config BR2_PACKAGE_LIBMETAL
	bool "libmetal"
	help
	  Xilinx libmetal userspace library built from embeddedsw.
```

## buildroot-external/package/librfdc/Config.in
```kconfig
config BR2_PACKAGE_LIBRFDC
	bool "librfdc"
	depends on BR2_PACKAGE_LIBMETAL
	help
	  Xilinx RFDC userspace library built from embeddedsw.
```

## buildroot-external/package/rootfs-fixups/Config.in
```kconfig
config BR2_PACKAGE_ROOTFS_FIXUPS
	bool "rootfs-fixups"
	help
	  Small target-finalize cleanup hooks used by this firmware builder.
```

## buildroot-external/package/t510-fnic-rfdc/Config.in
```kconfig
config BR2_PACKAGE_T510_FNIC_RFDC
	bool "t510-fnic-rfdc"
	select BR2_PACKAGE_LIBMETAL
	help
	  T510_FNIC userspace RFDC/LMK control program.
```
